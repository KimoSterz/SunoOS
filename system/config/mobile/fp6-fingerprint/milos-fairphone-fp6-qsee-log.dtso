// SPDX-License-Identifier: Apache-2.0
/dts-v1/;
/plugin/;

/*
 * Enable only the boot-lifetime, root-readable QSEE diagnostic ring carried
 * by Suno's diagnostic kernel. This overlay does not alter either dedicated
 * QSEE heap and does not enable a trustlet or biometric command.
 */

&{/firmware/scm} {
	Suno,qsee-log-diagnostic;
};
